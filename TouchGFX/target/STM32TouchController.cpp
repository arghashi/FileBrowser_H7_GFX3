/* USER CODE BEGIN Header */
/**
 ******************************************************************************
 * File Name          : STM32TouchController.cpp
 ******************************************************************************
 * This file is generated by TouchGFX Generator 4.19.0.
 ******************************************************************************
 * @attention
 *
 * Copyright (c) 2022 STMicroelectronics.
 * All rights reserved.
 *
 * This software is licensed under terms that can be found in the LICENSE file
 * in the root directory of this software component.
 * If no LICENSE file comes with this software, it is provided AS-IS.
 *
 ******************************************************************************
 */
/* USER CODE END Header */

/* USER CODE BEGIN STM32TouchController */

#include <STM32TouchController.hpp>
#include "main.h"


#ifdef XPT2046_ENABLE
#include "touch.h"  // اضافه کردن هدر کتابخانه تاچ
#include "cmsis_os2.h"

extern _m_tp_dev tp_dev;  // تعریف خارجی ساختار تاچ
extern TouchPoint tp;

extern osMutexId_t touch_mutexHandle;
#endif /*XPT2046_ENABLE*/


#ifdef GT911_ENABLE
extern "C"
{
#include "gt911.h"
}
static uint16_t X,Y;
#endif
void STM32TouchController::init()
{
#ifdef XPT2046_ENABLE
	TP_Init();  // مقداردهی اولیه تاچ اسکرین
#endif /*XPT2046_ENABLE*/
}

bool STM32TouchController::sampleTouch(int32_t &x, int32_t &y)
{
#ifdef XPT2046_ENABLE
	if (osMutexAcquire(touch_mutexHandle, 0) == osOK)
	{  // عدم بلوکینگ
		if (tp_dev.sta & TP_PRES_DOWN)
		{  // اگر تاچ تشخیص داده شد
			x = tp_dev.x[0];  // مختصات X
			y = tp_dev.y[0];  // مختصات Y
			osMutexRelease(touch_mutexHandle);

			return true;
		}
		osMutexRelease(touch_mutexHandle);
	}
#endif /*XPT2046_ENABLE*/
#ifdef GT911_ENABLE
	if(gt911_TS_DetectTouch(&X, &Y))
	{
//		TS_State.TouchDetected=1;
		x = X;
		y = Y;
		return true;
	}
#endif
	/**
	 * By default sampleTouch returns false,
	 * return true if a touch has been detected, otherwise false.
	 *
	 * Coordinates are passed to the caller by reference by x and y.
	 *
	 * This function is called by the TouchGFX framework.
	 * By default sampleTouch is called every tick, this can be adjusted by HAL::setTouchSampleRate(int8_t);
	 *
	 */
	return false;
}

/* USER CODE END STM32TouchController */

/************************ (C) COPYRIGHT STMicroelectronics *****END OF FILE****/
